## meta-krutrim/conf/layer.conf
```bitbake
# We have a conf and classes directory, add to BBPATH
BBPATH .= ":${LAYERDIR}"

# We have recipes-* directories, add to BBFILES
BBFILES += "${LAYERDIR}/recipes-*/*/*.bb \
            ${LAYERDIR}/recipes-*/*/*.bbappend"

# We have a templates directory, add to BBFILES
BBFILE_COLLECTIONS += "meta-krutrim"
BBFILE_PATTERN_meta-krutrim := "^${LAYERDIR}/"
LAYERSERIES_COMPAT_ibm-layer = "langdale mickledore"
```
